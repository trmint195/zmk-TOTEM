## config/west.yml
```yaml
manifest:
  remotes:
    - name: zmkfirmware
      url-base: https://github.com/zmkfirmware
    - name: carrefinho                           
      url-base: https://github.com/carrefinho   
    - name: felixJR123
      url-base: https://github.com/felixJR123
    - name: kien242
      url-base: https://github.com/kien242
  projects:
    - name: zmk
      remote: zmkfirmware
      revision: main
      import: app/west.yml
    - name: prospector-zmk-module               
      remote: carrefinho                         
      revision: feat/new-status-screens          
    - name: zmk-module-xiaord
      remote: felixJR123                    
      revision: main                                            
  self:
    path: config
    
```
